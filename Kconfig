## Kconfig
```kconfig
menuconfig SCALER
	bool "Enable Scaling Module"
	default n
	help
	    Enable the Scaling module for ZMK.

if SCALER

config ZMK_INPUT_PROCESSOR_SCALER
	bool "Enable Scaling Input Processor"
	default y
    depends on ZMK_INPUT_PROCESSORS
	help
	  Enable an input processor that scales relative mouse deltas by
	  (scale_coeff_milli/1000) * delta when scaling_mode is 1.

config ZMK_INPUT_PROCESSOR_SCALER_DEFAULT_COEFF_MILLI
	int "Default scale coefficient (milli)"
	default 100
	depends on ZMK_INPUT_PROCESSOR_SCALER
	help
	  Default milli coefficient used when the device tree property
	  scale-coeff-milli is not provided. 100 => 0.1.

endif # SCALER
```

## dts/bindings/input_processor/zmk,input-processor-scaler.yaml
```yaml
# SPDX-License-Identifier: MIT

title: ZMK Input Processor Scaler

description: |
  Scales relative mouse movements when scaling_mode is 1.

compatible: "zmk,input-processor-scaler"

include: base.yaml

properties:
  scaling-mode:
    type: int
    required: true
    enum: [0, 1]
    description: 0 disables scaling, 1 enables scaling (0.1 * delta)
  scale-coeff-milli:
    type: int
    required: false
    default: 100
    description: Coefficient in milli (e.g. 100 => 0.1). factor = coeff * delta
```

## dts/bindings/input_processors/zmk,input-processor-motion-scaler.yaml
```yaml
# SPDX-License-Identifier: MIT

description: |
  ZMK Input Processor Motion Scaler.
  Scales relative mouse movements when scaling_mode is 1 using
  y(x) = U * r^(p+1) / (1 + r^(p+1)) * sign(x), r = |x|/xs.

compatible: "zmk,input-processor-motion-scaler"

include: ip_zero_param.yaml

properties:
  scaling-mode:
    type: int
    required: false
    description: 0 disables scaling, 1 enables scaling.
  max-output:
    type: int
    required: false
    description: Maximum absolute output value |y|. Replaces 'u'. Default 127.
  half-input:
    type: int
    required: false
    description: Half-input xs used for r=|x|/xs. Replaces 'xs'. Default 50.
  exponent-tenths:
    type: int
    required: false
    description: Exponent p with 0.1 resolution (p*10). Replaces 'p-tenths'. Default 10.
  track-remainders:
    type: boolean
    required: false
    description: If present, track remainders from scaling and carry them over.
```
